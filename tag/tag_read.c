#include <string.h>
#include "types.h"
#include "iso14443a.h"
//#include "aes.h"
//#include "rc4.h"
#include "des.h"
//#include "simple_cipher.h"
#include "tag_read.h"
#include "mcu.h"


extern uint8_t g_pui8TrfBuffer[NFC_FIFO_SIZE];

static uint8_t s_cur_tag_id = 0;

const uint8_t s_static_pack[2] = {PACK0, PACK1};
//const uint8_t s_static_pwd_key[8] = {PWD0, PWD1, PWD2, PWD3, 0x00, 0x00, 0x00, 0x00};
//const uint8_t s_static_info_key[8] = {8, 87, 110, 234, 60, 43, 70, 213};
//const uint8_t s_static_auth_key[8] = {61, 203, 134, 185, 243, 207, 38, 24};
const uint8_t s_static_pwd_key_schedule[128]=
  {
    0x80, 0x30, 0x84, 0x80, 0x01, 0x07, 0x04, 0x88, 0x94, 0x30, 0x4c, 0xc8, 0x40, 0x00, 0x82, 0x80,
	0x40, 0x10, 0x48, 0x10, 0x49, 0x08, 0x88, 0x03, 0x40, 0x80, 0x20, 0x08, 0x83, 0xc8, 0x41, 0x0a,
	0x84, 0xc0, 0x44, 0x60, 0x02, 0x02, 0x01, 0x48, 0x20, 0x34, 0x04, 0x54, 0x48, 0x02, 0x00, 0x46,
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	0x0c, 0x84, 0xa8, 0x24, 0x05, 0x83, 0x00, 0x02, 0x84, 0x00, 0x80, 0x2c, 0x02, 0xc2, 0x04, 0x81
  };
const uint8_t s_static_info_key_schedule[128]=
  {
    0x24, 0xb8, 0x64, 0x58, 0x8e, 0x04, 0x47, 0xcd, 0x18, 0xdc, 0x54, 0xa0, 0x4f, 0x80, 0x87, 0x4e,
	0xf8, 0x00, 0x90, 0x54, 0x06, 0x4f, 0x40, 0x4f, 0x04, 0xac, 0xbc, 0xec, 0x4e, 0xc1, 0x05, 0xc0,
	0xdc, 0x10, 0xc4, 0xd4, 0x0d, 0x86, 0xce, 0x81, 0x90, 0x3c, 0xa8, 0xb8, 0xc8, 0x09, 0xc1, 0x8f,
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	0x54, 0x44, 0x14, 0xfc, 0x0b, 0x4f, 0x0a, 0x09, 0xc4, 0x08, 0xf8, 0x48, 0x81, 0x0d, 0xc6, 0x8c
  };
const uint8_t s_static_auth_key_schedule[128]=
  {
    0xbc, 0x2c, 0xbc, 0x44, 0x45, 0x0a, 0x4b, 0x4d, 0xc0, 0x6c, 0x60, 0x28, 0x4f, 0x48, 0xcc, 0x87,
	0x7c, 0x80, 0xdc, 0x68, 0xc0, 0xc4, 0xcb, 0x0a, 0xc4, 0x58, 0x4c, 0xb0, 0x8f, 0x03, 0x01, 0x46,
	0x28, 0x74, 0xbc, 0x54, 0x43, 0xc8, 0x47, 0x0b, 0xf4, 0x84, 0x2c, 0xf8, 0x0d, 0x0d, 0x08, 0xc8,
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	0xc0, 0xf8, 0x18, 0x90, 0x0f, 0xc6, 0x84, 0x4e, 0xb0, 0x30, 0x58, 0xfc, 0xc8, 0x87, 0x42, 0x83
  };


static TAG_INFO_T s_tag_info[TOTAL_TAG_NUM] = {0};


void set_cur_tag_id(uint8_t id)
{
    s_cur_tag_id = id;
}

static void pwdAuth(TAG_INFO_T *pinfo)
{
  uint8_t raw_data[8];
  DesEncrypt8((const DES_key_schedule*)(s_static_pwd_key_schedule), pinfo->tag_uid, raw_data);
  
  // set pack
  ISO14443A_sendT2TPwdAuth(raw_data, s_static_pack);
}

static void DecryptTagInfo(TAG_INFO_T *pinfo)
{
  uint8_t *ptemp;
  uint8_t raw_data[16];
  // read data start from buf[1]
  DesDecrypt16((const DES_key_schedule*)(s_static_info_key_schedule), &g_pui8TrfBuffer[0], raw_data);
  memcpy(pinfo->filter_uid, raw_data, FILTER_UID_LEN);
  ptemp = raw_data + FILTER_UID_LEN;
  pinfo->year = (*ptemp << 8) | *(ptemp+1);
  ptemp += 2;
  pinfo->month = *ptemp++;
  pinfo->day = *ptemp++;
  pinfo->manufacturer = *ptemp++;
  pinfo->filter_type = *ptemp++;
}

static void DecryptAuthInfo(TAG_INFO_T *pinfo)
{
  uint8_t i, j;
  uint8_t raw_data[16];
  // read data start from buf[1]
  DesDecrypt16((const DES_key_schedule*)(s_static_auth_key_schedule), &g_pui8TrfBuffer[0], raw_data);
  
  pinfo->is_auth = 1;
  for (i = 0, j = 0; i < 8; i++, j += 2) 
  {
    if (pinfo->tag_uid[i] != (raw_data[j] ^ raw_data[j+1])) 
    {
        pinfo->is_auth = 0;
        break;
    }
  }
}

uint8_t parse_tag_info(void)
{
    TAG_INFO_T *pinfo;

    if (s_cur_tag_id >= TOTAL_TAG_NUM) {
        return 0;
    }

    pinfo = &s_tag_info[s_cur_tag_id];

    // 1. read TAG UID.
    ISO14443A_sendT2TReadFourBlocks(TAG_UID_START_BLOCK);
    //same uid and the tag is authed last time, discard this loop.
    if(pinfo->is_auth)
    {
	  	LED_14443A_ON;
	    return 1;
    }
    pinfo->tag_uid[1] = 0;
    memcpy(&pinfo->tag_uid[1], &g_pui8TrfBuffer[0], 3);
    memcpy(&pinfo->tag_uid[4], &g_pui8TrfBuffer[4], 4);
#ifdef TAG_USE_PWD_AUTH
    pwdAuth(pinfo);
#endif

    // 2. read TAG info.
    ISO14443A_sendT2TReadFourBlocks(TAG_INFO_START_BLOCK);
    DecryptTagInfo(pinfo);
    //check year and month
    if((((pinfo->filter_uid[0] >> 4) + 2017) != pinfo->year) || ((pinfo->filter_uid[0] & 0x0F) != pinfo->month))
    {
            pinfo->filter_type = 0x04; //0xFF; // invalid filter
            pinfo->is_auth = 0x00;
            return 2;
    }


    // 3. read AUTH info from TAG.
    ISO14443A_sendT2TReadFourBlocks(TAG_AUTH_START_BLOCK);
    DecryptAuthInfo(pinfo);


    if (pinfo->is_auth) 
    {
      LED_14443A_ON;
      return 1;
    } 
    pinfo->filter_type = 0x04; //0xFF; // invalid filter
    return 2;
}

const TAG_INFO_T * get_tag_info(uint8_t id)
{
    if (id >= TOTAL_TAG_NUM) {
        return NULL;
    } else {
        return &s_tag_info[id];
    }
}

int8_t clear_tag_info(uint8_t id)
{
    TAG_INFO_T *pinfo;

    if (id >= TOTAL_TAG_NUM) {
        return -1;
    } else {
        pinfo = &s_tag_info[id];
        memset(pinfo, 0x00, sizeof(TAG_INFO_T));
        pinfo->filter_type = 0xFF; // no tag found
    }

    return 0;
}

